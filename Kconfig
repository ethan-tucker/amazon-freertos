## libraries/freertos_plus/standard/freertos_plus_tcp/KConfig
```kconfig
if TCP_ENABLED
    menu "TCP library configuration options"

        menu "Constants affecting the TCP/IP task execution behavior"
            config IP_TASK_PRIORITY
                int "IP task priority"
                help
                    The priority is a standard FreeRTOS task priority. 
                    The task priority is (configMAX_PRIORITIES - <user entered value>).
                    The larger the user entered value the lower the priority.


            config IP_TASK_STACK_SIZE_WORDS
                int "IP Task size words"

            config IP_USE_NETWORK_EVENT_HOOK
                bool "Use network event hook"

            config IP_EVENT_QUEUE_LENGTH
                int "Event queue length"
                help
                    Must be at least NUM_NETWORK_BUFFER_DESCRIPTORS + 5
        endmenu

        menu "Debug, trace, and logging settings"
            config IP_HAS_DEBUG_PRINTF
                bool "Has debug printf"

            config IP_FREERTOS_DEBUG_PRINTF_FUNC
                string "FreeRTOS debub printf"
                depends on IP_HAS_DEBUG_PRINTF

            config IP_HAS_PRINTF
                bool "Has printf"

            config IP_FREERTOS_PRINTF_FUNC
                string "FreeRTOS printf"
                depends on IP_HAS_PRINTF

            config IP_TCP_MAY_LOG_PORT_FUNC
                string "TCP may log port"
                default "#define TCP_MAY_LOG_PORT(xPort) ( ( xPort ) != 23U )"

            config IP_CHECK_IP_QUEUE_SPACE
                bool "Check IP queue space"
                default n

            config IP_WATCHDOG_TIMER_FUNC
                string
                default ""
        endmenu

        menu "Hardware and Driver Specific Settings"
            choice BYTE_ORDER
                bool "Byte order"

                config IP_pdFREERTOS_BIG_ENDIAN
                    bool "FreeRTOS big endian"

                config IP_pdFREERTOS_LITTLE_ENDIAN
                    bool "FreeRTOS little endian"
        
            endchoice

            config IP_DRIVER_INCLUDED_TX_IP_CHECKSUM
                bool "Driver included tx ip checksum"
                default n

            config IP_DRIVER_INCLUDED_RX_IP_CHECKSUM
                bool "Driver included rx ip checksum"
                default n

            config IP_ETHERNET_DRIVER_FILTERS_FRAME_TYPES
                bool "Ethernet driver filters frame types"
                default n

            config IP_ETHERNET_DRIVER_FILTERS_PACKETS
                bool "Ethernt driver filters packets"
                default n

            config IP_NETWORK_MTU
                int "Network MTU"
                default 1500
                range 46 1500

            config IP_NUM_NETWORK_BUFFER_DESCRIPTORS
                int "Num network buffer descriptors"
                default 45

            config IP_FILTER_OUT_NON_ETHERNET_II_FRAMES
                bool "Filets out non ethernet II frames"
                default y

            config IP_USE_LINKED_RX_MESSAGES
                bool "Use linked RX messages"
                default 0
            
            config IP_ZERO_COPY_TX_DRIVERS
                bool "Zero copy TX drivers"
                default 0

            config IP_BUFFER_PADDING
                int "Buffer padding"
                default 0

            config IP_PACKET_FILLING_SIZE
                int "Packet filling size"
                default 2
        endmenu

        menu "TCP specific constants"

            config IP_USE_TCP
                bool "Use TCP"
                default y
            
            if IP_USE_TCP
                config IP_USE_TCP_WIN
                    bool "Use TCP win"
                    default y

                config IP_TCP_WIN_SEG_COUNT
                    int "TCP win seg count"
                    default 256
                    depends on IP_USE_TCP_WIN
                
                config IP_IGNORE_UNKNOWN_PACKETS
                    bool "Ignore unkown packets"
                    default n
            
            endif

            config IP_TCP_TIME_TO_LIVE
                int "TCP time to live"
                default 128

            config IP_TCP_RX_BUFFER_LENGTH
                int "TCP RX buffer length"

            config IP_TCP_TX_BUFFER_LENGTH
                int "TCP TX buffer length"

            config IP_USE_TCP_TIMSTAMPS
                bool "Use TCP timestamps"

            config IP_TCP_MSS
                int "TCP MSS"

            config IP_TCP_KEEP_ALIVE
                bool "TCP keep alive"
                default n

            config IP_TCP_KEEP_ALIVE_INTERVAL
                int "TCP keep alive interval"
                depends on IP_TCP_KEEP_ALIVE
                help
                    Value entered is in seconds.

            config IP_TCP_HANG_PROTECTION
                bool "TCP hang protection"
                default y

            config IP_TCP_HANG_PROTECTION_TIME
                int "TCP hang protection time"
                default 30
                depends on TCP_HANG_PROTECTION
                help
                    Value enetered is in seconds.

        endmenu

        menu "UDP Specific Constants"
            config IP_UDP_TIME_TO_LIVE
                int "UDP time to live"
                default 128

            config IP_UDP_MAX_SEND_BLOCK_TIME_TICKS
                int "UDP max send block time ticks"
                help
                    Value entered is in milliseconds.

            config IP_UDP_MAX_RX_PACKETS
                int "UDP max rx packets"
                default 0
        endmenu

        menu "Other constants effecting socket behavior"
            config IP_INCLUDE_FULL_INET_ADDR
                bool "Include full inet addr"
                default y

            config IP_ALLOW_SOCKET_SEND_WITHOUT_BIND
                bool "Allow socket send without bind"
                default y

            config IP_SOCK_DEFAULT_RECEIVE_BLOCK_TIME
                int "Socket default receive block time"

            config IP_SOCK_DEFAULT_SEND_BLOCK_TIME
                int "Socket default send block time"

            config IP_SOCKET_HAS_USER_SEMAPHORE
                bool "Socket has user semaphore"
                default n

            config IP_SUPPORT_SINGALS
                bool "Support signals"
                default n

            config IP_SUPPORT_SELECT_FUNCTION
                bool "Support select function"
                default n
        endmenu

        menu "Constants affecting the ARP behavior"
            config IP_ARP_CACHE_ENTRIES
                int "ARP cache entries"
                default 10

            config IP_MAX_ARP_RETRANSMISSIONS
                int "Max ARP retransmissions"
                default 5

            config IP_MAX_ARP_AGE
                int "Max ARP age"
                default 150
                help 
                    Value is in 10s of seconds

            config IP_ARP_REVERSED_LOOKUP
                bool "ARP reversed lookup"
                default n

            config IP_ARP_STORES_REMOTE_ADDRESSES
                bool "ARP stores remote addresses"
                default n

            config IP_USE_ARP_REVERSED_LOOKUP
                bool "Use ARP reversed lookup"
                default n

            config IP_USE_ARP_REMOVE_ENTRY
                bool "Use ARP remove entry"
                default n
        endmenu

        menu "Constants affecting DHCP and name service behavior"
            config IP_USE_DNS
                bool "Use DNS"
                default y

            if IP_USE_DNS
                config IP_USE_LLMR
                    bool "Use LLMR"
                    default n

                config IP_USE_NBNS
                    bool "Use NBNS"
                    default n
            endif

            config IP_USE_DNS_CACHE
                bool "Use DNS cache"
                default y

            if IP_USE_DNS_CACHE
                config IP_DNS_CACHE_ENTRIES
                    bool "DNS cache entries"
                    default y

                config IP_DNS_CACHE_NAME_LENGTH
                    int "DNS cache name length"
                    default 254
            endif

            config IP_DNS_REQUEST_ATTEMPTS
                int "DNS request attempts"
                default 5

            config IP_USE_DHCP
                bool "Use DHCP"
                default y

            config IP_MAXIMUM_DISCOVER_TX_PERIOD
                int "Maximum discover TX period"
                help
                    Value entered in ticks.

            config IP_USE_DHCP_HOOK
                bool "Use DHCP hook"
                default n

            config IP_DHCP_REGISTER_HOSTNAME
                bool "DHCP register hostname"
                default n
        endmenu

        menu "Constants affecting IP and ICMP behavior"
            config IP_CAN_FRAGMENT_OUTGOING_PACKETS
                bool "Can fragment outgoing packets"

            config IP_REPLY_TO_INCOMING_PINGS
                bool "Reply to incoming pings"
                default y
            
            config IP_SUPPORT_OUTGOING_PINGS
                bool "Support outgoing pings"
                default n
        endmenu

        menu "Constants providing target support"
            config IP_RAND32_FUNC
                string "Rand32"
                default "rand()"

            config IP_HAS_INLINE_FUNCTIONS
                bool "Has inline functions"
                default y
        endmenu
    endmenu
endif
```

## tools/configuration/KConfig
```kconfig
# Variable defaults that determine whether or not a board has certain capabilities. These values are overwritten
menu "Board Properties"
    config OTA_ENABLED
        bool "Ota enabled"
        default y

    config MQTT_ENABLED
        bool "Mqtt enabled"
        default y


    config TCP_ENABLED
        bool "Tcp enabled"
        default y

        
    config WIFI_ENABLED
        bool "Wifi enabled"
        default y
endmenu

menu "Libary configurations"
    # sourcing library configuration
    source "../../libraries/*/*/*/KConfig"
endmenu

menu "WiFi configuration"
depends on WIFI_ENABLED

config WIFI_SSID
    string "WiFi SSID"
    help
        The SSID of your wifi router.

config WIFI_PASSWORD
    string "WiFi password"
    help
        The password of your wifi router.

choice WIFI_SECURITY
bool "Select your wifi security type"

config WIFI_SECURITY_OPEN
    bool "Wifi security type open"

config WIFI_SECURITY_WEP
    bool "Wifi security type wep"

config WIFI_SECURITY_WPA
    bool "Wifi security type wpa"

config WIFI_SECURITY_WPA2
    bool "Wifi security type wpa2"

endchoice
endmenu

menu "Ethernet configuration"
depends on !WIFI_ENABLED
    config NETWORK_INTERFACE
        int "Network interface to use for ethernet"
        default 1
endmenu

menu "AWS configuration"

config IOT_ENDPOINT
    string "AWS IoT endpoint"
    help
        The endpoint associated with your aws account.
    default "<IOT_ENDPOINT>"

config THING_NAME
    string "AWS Thing name"
    help
        The endpoint associated with your aws account.
    default "<THING_NAME>"

config THING_CERT
    string "Thing certificate"
    help
        The certificate associated with your registered thing.
    default "<THING_CERT>"

config THING_PRIVATE_KEY
    string "Thing private key"
    help
        The private key associated with your registered thing.
    default "<THING_PRIVATE_KEY>"

endmenu

choice "Demo Selection"
    bool "Demo selection"
    config MQTT_DEMO_ENABLED
        bool "MQTT demo"
        depends on MQTT_ENABLED

    config SHADOW_DEMO_ENABLED
        bool "Shadow demo"
        depends on MQTT_ENABLED

    config OTA_DEMO_ENABLED
        bool "OTA update demo"
        depends on OTA_ENABLED
endchoice
```

## vendors/Kconfig
```kconfig
choice TARGET_VENDOR
    bool "Select the target vendor"

    config cypress
        bool "cypress"
    if cypress
        source "vendors/cypress/Kconfig"
    endif

    config espressif
        bool "espressif"
    if espressif
        source "vendors/espressif/Kconfig"
    endif

    config infineon
        bool "infineon"
    if infineon
        source "vendors/infineon/Kconfig"
    endif

    config nuvoton
        bool "nuvoton"
    if nuvoton
        source "vendors/nuvoton/Kconfig"
    endif

    config nxp
        bool "nxp"
    if nxp
        source "vendors/nxp/Kconfig"
    endif

    config pc
        bool "pc"
    if pc
        source "vendors/pc/Kconfig"
    endif

    config renesas
        bool "renesas"
    if renesas
        source "vendors/renesas/Kconfig"
    endif

    config st
        bool "st"
    if st
        source "vendors/st/Kconfig"
    endif

    config ti
        bool "ti"
    if ti
        source "vendors/ti/Kconfig"
    endif

    config vendor
        bool "vendor"
    if vendor
        source "vendors/vendor/Kconfig"
    endif

    config xilinx
        bool "xilinx"
    if xilinx
        source "vendors/xilinx/Kconfig"
    endif
endchoice
```

## vendors/cypress/Kconfig
```kconfig
if BOARD_CY8CKIT_064S0S2_4343W
    rsource "boards/CY8CKIT_064S0S2_4343W/Kconfig"
endif

if BOARD_CYW943907AEVAL1F
    rsource "boards/CYW943907AEVAL1F/Kconfig"
endif

if BOARD_CYW954907AEVAL1F
    rsource "boards/CYW954907AEVAL1F/Kconfig"
endif
```

## vendors/pc/boards/linux/Kconfig
```kconfig
config OTA_SUPPORTED
    bool
    default n

config WIFI_ENABLED
    bool
    default n
```

## vendors/ti/boards/cc3220_launchpad/Kconfig
```kconfig
config OTA_SUPPORTED
    bool
    default y

config MQTT_SUPPORTED   
    bool
    default y

config TCP_SUPPORTED   
    bool
    default y

config WIFI_ENABLED
    bool
    default y
```
