## Kconfig
```kconfig
#Displays the board options and loads the board configurations for the chosen board
choice TARGET_BOARD
    bool "Select the target board"
    source "vendors/*/boards_Kconfig"
endchoice


menu "Library configurations"

#Sources the boolean variables to keep track of what library variables have been defined
#at the demo, board, and libary level
source "libraries/*/*/*/def_KConfig"

#Sources the library configuration file, which first sources configurations for the library for the selected board
source "libraries/*/*/*/KConfig"

config TCP_ENABLED
    bool "Enable TCP Library"
    default y
    depends on TCP_SUPPORTED
    help
        Choose to enable the TCP library and its configurations.

endmenu

menu "WiFi configuration"
depends on WIFI_ENABLED

config WIFI_SSID
    string "WiFi SSID"
    help
        The SSID of your wifi router.

config WIFI_PASSWORD
    string "WiFi password"
    help
        The password of your wifi router.

choice WIFI_SECURITY
bool "Select your wifi security type"

config WIFI_SECURITY_OPEN
    bool "Wifi security type open"

config WIFI_SECURITY_WEP
    bool "Wifi security type wep"

config WIFI_SECURITY_WPA
    bool "Wifi security type wpa"

config WIFI_SECURITY_WPA2
    bool "Wifi security type wpa2"

endchoice
endmenu

menu "Ethernet configuration"
depends on !WIFI_ENABLED
    config NETWORK_INTERFACE
        int "Network interface to use for ethernet"
        default 1
endmenu

menu "AWS configuration"

config IOT_ENDPOINT
    string "AWS IoT endpoint"
    help
        The endpoint associated with your aws account.

config THING_NAME
    string "AWS Thing name"
    help
        The endpoint associated with your aws account.

config THING_CERT
    string "Thing certificate"
    help
        The certificate associated with your registered thing.

config THING_PRIVATE_KEY
    string "Thing private key"
    help
        The private key associated with your registered thing.

endmenu

choice "Demo Selection"
    bool "Select a demo to enable"
    
    config MQTT_DEMO_ENABLED
        bool "MQTT demo"
        depends on MQTT_ENABLED

    config SHADOW_DEMO_ENABLED
        bool "Shadow demo"
        depends on MQTT_ENABLED

    config OTA_DEMO_ENABLED
        bool "OTA update demo"
        depends on OTA_ENABLED
endchoice
```

## demos/include/Kconfig
```kconfig
choice TARGET_BOARD
    bool "Select the target board"
    
    config ESP32
        bool "Espressif ESP32"

    config nrf52840-df
        bool "Nordic nrf52840-dk"      
endchoice

menu "Device configuration"

config WIFI_SSID
    string "WiFi SSID"
    help
        The SSID of your wifi router.

config WIFI_PASSWORD
    string "WiFi password"
    help
        The password of your wifi router.

config WIFI_SECURITY
    string "WiFi security"
    help
        The security type of your Wi-Fi network

endmenu

menu "AWS configuration"

config IOT_ENDPOINT
    string "AWS IoT endpoint"
    help
        The endpoint associated with your aws account.

config THING_NAME
    string "Thing name"
    help
        The thing name associated with your device.

endmenu
```

## libraries/c_sdk/standard/mqtt/KConfig
```kconfig
if MQTT_ENABLED

    menu "MQTT library configuration options"
    config MQTT_ENABLE_METRICS
        bool "Enable metrics"
        default y

    config MQTT_KEEP_ALIVE_INTERVAL_SECONDS
        int "Keep alive interval"
        default 1200

    config MQTT_KEEP_ALIVE_ACTUAL_INTERVAL_TICKS
        int "Keep alive actual interval ticks"
        default 5000

    config MQTT_KEEP_ALIVE_TIMEOUT_TICKS 
        int "Keep alive timeout ticks"
        default 1000

    config MQTT_TASK_MAX_BLOCK_TICKS
        int "Task max block ticks"

    config MQTT_TASK_STACK_DEPTH_DEPENDS_ON_STACK_SIZE
        bool "Task stack depth depends on minimal stack size"
        default y

    config MQTT_TASK_STACK_DEPTH_MULTIPLIER
        int "Task stack depth multiplier"
        default 4
        depends on MQTT_TASK_STACK_DEPTH_DEPENDS_ON_STACK_SIZE

    config MQTT_TASK_STACK_DEPTH
        int "Task stack depth"
        depends on !MQTT_TASK_STACK_DEPTH_DEPENDS_ON_STACK_SIZE

    config MQTT_TASK_PRIORITY_DEPENDS_ON_MAX_PRIORITY
        bool "Task priority depends on the max task priority"
        default y
        help
            False means that task priority depends on the min task priority

    config MQTT_TASK_PRIORITY_DIFFERENCE
        int "Difference between max priority and task priority"
        default 4
        depends on MQTT_TASK_PRIORITY_DEPENDS_ON_MAX_PRIORITY
        help
            Task Priority = MAX_PRIORITY - <ENTERED_VALUE>

    config MQTT_TASK_PRIORITY 
        int "Task Priority"
        default 0
        depends on !MQTT_TASK_PRIORITY_DEPENDS_ON_MAX_PRIORITY
        help
            Task Priority = idle_Priority + <ENTERED_VALUE>

    config MQTT_MAX_BROKERS 
        int "Max brokers"
        default 1

    config MQTT_MAX_PARALLEL_OPS
        int "Max parallel ops"
        default 5

    config MQTT_TCP_SEND_TIMEOUT_MS
        int "TCP send timeout ms"
        default 2000

    config MQTT_RX_BUFFER_SIZE
        int "RX buffer size"
        default 1024

    endmenu
endif
```

## libraries/freertos_plus/aws/ota/KConfig
```kconfig
if OTA_SUPPORTED

config OTA_ENABLED
    bool "Enable OTA Library"
    default y
    help
        Choose to enable the OTA library and its configurations.

if OTA_ENABLED
    source "vendors/*/boards/*/aws_demos/config_files/ota_Kconfig"
    
    config STACK_SIZE
        int "Stack size"
        depends on !STACK_SIZE_SET_DEMO && !STACK_SIZE_SET_BOARD

    config LOG2_FILE_BLOCK_SIZE
        int "Log 2 file block size"
        default 10
        depends on !LOG2_FILE_BLOCK_SIZE_SET_DEMO && !LOG2_FILE_BLOCK_SIZE_SET_BOARD

    config SELF_TEST_RESPONSE_WAIT_MS
        int "Self test response wait (milliseconds)"
        default 16000
        depends on !SELF_TEST_RESPONSE_WAIT_MS_SET_DEMO && !SELF_TEST_RESPONSE_WAIT_MS_SET_BOARD


    config FILE_REQUEST_WAIT_MS
        int "File request wait (milliseconds)"
        default 10000
        depends on !FILE_REQUEST_WAIT_MS_SET_DEMO && !FILE_REQUEST_WAIT_MS_SET_BOARD

    config OTA_AGENT_PRIORITY
        int "OTA agent priority"
        default 0
        help
            0 is the lowest priority.
        depends on !OTA_AGENT_PRIORITY_SET_DEMO && !OTA_AGENT_PRIORITY_SET_BOARD

    config MAX_THINGNAME_LEN
        int "Max thingname length"
        default 64
        depends on !MAX_THINGNAME_LEN_SET_DEMO && !MAX_THINGNAME_LEN_SET_BOARD

    config MAX_NUM_BLOCKS_REQUEST
        int "Max num of blocks requested"
        default 1
        depends on !MAX_NUM_BLOCKS_REQUEST_SET_DEMO && !MAX_NUM_BLOCKS_REQUEST_SET_BOARD

    config MAX_NUM_REQUEST_MOMENTUM
        int "Max num request momentum"
        default 32
        depends on !MAX_NUM_REQUEST_MOMENTUM_SET_DEMO && !MAX_NUM_REQUEST_MOMENTUM_SET_BOARD

    config MAX_NUM_OTA_DATA_BUFFERS
        int "Max num OTA data buffers"
        default 4
        depends on !MAX_NUM_OTA_DATA_BUFFERS_SET_DEMO && !MAX_NUM_OTA_DATA_BUFFERS_SET_BOARD

    config ALLOW_DOWNGRADE
        bool "Allow downgrades"
        depends on !ALLOW_DOWNGRADE_SET_DEMO && !ALLOW_DOWNGRADE_SET_BOARD

    if !ENABLED_CONTROL_PROTOCOLS_SET_DEMO && !ENABLED_CONTROL_PROTOCOLS_SET_BOARD
    choice ENABLED_CONTROL_PROTOCOLS
        bool "Enabled control protocols" 

        config ENABLED_CONTROL_PROTOCOLS_MQTT
            bool "OTA data over MQTT"
            

        config ENABLED_CONTROL_PROTOCOLS_HTTP
            bool "OTA data over HTTP"

        config ENABLED_CONTROL_PROTOCOLS_HTTP_AND_MQTT
            bool "OTA data over HTTP and MQTT"
    endchoice
    endif

    if !ENABLED_DATA_PROTOCOLS_SET_DEMO && !ENABLED_DATA_PROTOCOLS_SET_BOARD
    choice ENABLED_DATA_PROTOCOLS
        bool "Enabled data protocols"

        config ENABLED_DATA_PROTOCOLS_HTTP_AND_MQTT
            bool "OTA data over HTTP and MQTT"

        config ENABLED_DATA_PROTOCOLS_HTTP
            bool "OTA data over HTTP"

        config ENABLED_DATA_PROTOCOLS_MQTT
            bool "OTA data over MQTT"

    endchoice
    endif

    if !PRIMARY_DATA_PROTOCOL_SET_DEMO && !PRIMARY_DATA_PROTOCOL_SET_BOARD
    choice PRIMARY_DATA_PROTOCOL
        bool "Select a primary data protocol"

        config PRIMARY_DATA_PROTOCOLS_MQTT
            bool "MQTT as primary data protocol"
            depends on (ENABLED_DATA_PROTOCOLS_HTTP_AND_MQTT || ENABLED_DATA_PROTOCOLS_MQTT)

        config PRIMARY_DATA_PROTOCOLS_HTTP
            bool "HTTP as primary data protocol"
            depends on (ENABLED_DATA_PROTOCOLS_HTTP_AND_MQTT || ENABLED_DATA_PROTOCOLS_HTTP)
    endchoice
    endif
endif
endif
```
